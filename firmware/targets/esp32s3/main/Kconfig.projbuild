## firmware/targets/esp32s3/main/Kconfig.projbuild
```kconfig
menu "DragonBench"
config DB_WIFI_SSID
    string "Optional station Wi-Fi SSID"
    default ""
config DB_WIFI_PASSWORD
    string "Optional station Wi-Fi password"
    default ""
config DB_AP_PASSWORD
    string "Direct access-point password"
    default "Dragon$ru1e"
config DB_HOSTNAME
    string "mDNS hostname"
    default "dragonbench"
config DB_FIRMWARE_VERSION
    string "Firmware version"
    default "0.1.0"
config DB_TARGET_NAME
    string "Target identifier reported in events and /api/v1/device"
    default "esp32s3-n8r8"
    help
        Must be one of the target values in protocol/event.schema.json.
        Set per board by the sdkconfig.defaults.<board> overlay.
config DB_RF_SWITCH_GPIO
    int "Antenna RF-switch select GPIO (-1 if the board has none)"
    range -1 48
    default -1
    help
        Driven low at boot to select the onboard antenna.
        TinyS3[D]: GPIO38 (high selects the external U.FL connector).
endmenu
```

## sdkconfig.defaults
```kconfig
CONFIG_IDF_TARGET="esp32s3"
CONFIG_ESPTOOLPY_FLASHSIZE_8MB=y
CONFIG_ESPTOOLPY_FLASHFREQ_80M=y
CONFIG_SPIRAM=y
CONFIG_SPIRAM_MODE_OCT=y
CONFIG_SPIRAM_SPEED_80M=y
CONFIG_PARTITION_TABLE_CUSTOM=y
CONFIG_PARTITION_TABLE_CUSTOM_FILENAME="partitions.csv"
CONFIG_COMPILER_WARN_WRITE_STRINGS=y
CONFIG_COMPILER_OPTIMIZATION_SIZE=y
CONFIG_ESP_TASK_WDT_INIT=y
CONFIG_ESP_TASK_WDT_TIMEOUT_S=10
CONFIG_HTTPD_MAX_REQ_HDR_LEN=2048
CONFIG_LWIP_MAX_SOCKETS=16
# DragonBench always creates both the AP and STA netifs; advertise on both.
CONFIG_MDNS_MAX_INTERFACES=2
CONFIG_MDNS_PREDEF_NETIF_AP=y
CONFIG_MDNS_PREDEF_NETIF_STA=y
# CONFIG_MDNS_PREDEF_NETIF_ETH is not set
```
